#include <SPI.h>
#include <Adafruit_GFX.h>
#include <TFT_ILI9340.h>

#define __CS 10
#define __DC 9
#define __RST 14

// Color definitions
#define	BLACK   0x0000
#define	BLUE    0x001F
#define	RED     0xF800
#define	GREEN   0x07E0
#define CYAN    0x07FF
#define MAGENTA 0xF81F
#define YELLOW  0xFFE0  
#define WHITE   0xFFFF

float sin_d[] = { 
  0,0.17,0.34,0.5,0.64,0.77,0.87,0.94,0.98,1,0.98,0.94,
  0.87,0.77,0.64,0.5,0.34,0.17,0,-0.17,-0.34,-0.5,-0.64,
  -0.77,-0.87,-0.94,-0.98,-1,-0.98,-0.94,-0.87,-0.77,
  -0.64,-0.5,-0.34,-0.17 };
float cos_d[] = { 
  1,0.98,0.94,0.87,0.77,0.64,0.5,0.34,0.17,0,-0.17,-0.34,
  -0.5,-0.64,-0.77,-0.87,-0.94,-0.98,-1,-0.98,-0.94,-0.87,
  -0.77,-0.64,-0.5,-0.34,-0.17,0,0.17,0.34,0.5,0.64,0.77,
  0.87,0.94,0.98};
float d = 10;
float px[] = { 
  -d,  d,  d, -d, -d,  d,  d, -d };
float py[] = { 
  -d, -d,  d,  d, -d, -d,  d,  d };
float pz[] = { 
  -d, -d, -d, -d,  d,  d,  d,  d };

float p2x[] = {
  0,0,0,0,0,0,0,0};
float p2y[] = {
  0,0,0,0,0,0,0,0};

int r[] = {
  0,0,0};

int8_t cos_wave[512] =  
{
-128,-127,-127,-127,-127,-127,-127,-127,-127,-127,-127,-126,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-127
};

uint8_t ucos_wave[512] = 
{
0,0,0,0,0,0,0,0,0,0,0,1,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0
};

int rainbowColors[180];

TFT_ILI9340 tft = TFT_ILI9340(__CS, __DC);

void setup() {
  tft.begin();
  tft.setBitrate(24000000);
  
  tft.setRotation(1);
  tft.setTextColor(0xFFFF,0x0000);

  
  for (int i=0; i<180; i++) {
    int hue = i*2;
    int saturation = 100;
    int lightness = 50;
    // pre-compute the 180 rainbow colors
    rainbowColors[i] = makeColor(hue, saturation, lightness);
  }
}


int centerX = 239;
int centerY = 319;
unsigned int color = 0;

void loop(void) {
  loop_plasma();
}

inline int8_t fastCosineCalc( uint16_t preWrapVal)
{
  return cos_wave[preWrapVal % 512];
}

inline uint8_t fastUCosineCalc( uint16_t preWrapVal)
{
  return ucos_wave[preWrapVal % 512];
}

void loop_plasma(void) {
  static unsigned int time = 1;
  time++;

  unsigned int newTime = micros();

  tft.setAddrWindow(0,0,320,240);

  for (int y=0; y < 240; y++)
  {
    for (int x=0; x < 320; x++)
    {
          int cx = (x-160) + fastCosineCalc(time*3)/8;
          int cy = (y-120) + fastCosineCalc(time*2 + 64)/8;
          int v1 = fastCosineCalc((cx*cx+cy*cy)/32+1+time);
          
          int v2 = fastCosineCalc(2*x+2*time);
          
          int v3 = fastCosineCalc(((x-64) * fastCosineCalc(time*5)/16) + ((y-64) * fastCosineCalc(time*4)/16) + time);
          
          int v = (v1+v2+v3);
          
          uint8_t r = fastUCosineCalc(v);
          uint8_t g = fastUCosineCalc(2*v+128);
          uint8_t b = fastUCosineCalc(3*v+256);
          
          tft.writedata16(((r & 0xF8) << 8) | ((g & 0xFC) << 3) | (b >> 3));
    }
  }
  tft.setCursor(0, 232);
  tft.printf("%06d", micros() - newTime);
}

void loop_oold(void) {
  // Test Text
  /*testText();
  delay(3000);*/
  
  // Test Color
  for (color = 0; color < 512; color++)
  {
  unsigned int newTime = micros();

  for (int x=0; x < 240; x++) {
    for (int y=0; y < 320; y++) {
      if(y > 7 || x > 35) {
        int index = color + ((x*2-centerX)*(x*2-centerX) + (y*2-centerY)*(y*2-centerY))/256;
        int oldIndex = index-1;
        tft.drawPixel(x,y, rainbowColors[index%180]);

        /*if(y < 32)
        {
          tft.drawPixel(x,y, x/4);
        }
        else if(y < 64)
        {
          tft.drawPixel(x,y, (x/2)<<5);
        }
        else if (y < 96)
        {
          tft.drawPixel(x,y, (x/4)<<11);
        }
        else
        {
          tft.drawPixel(x,y, 0b0000011111100000);
        }*/
      }
    }
  }
      tft.setCursor(0, 0);
      tft.printf("%06d", micros() - newTime);
  }
  /*for (color = 0; color < 512; color)
  {
    test3D();
    delay(15);

  }   */
}

void testText() {
  tft.fillScreen(0);
  tft.setCursor(0, 0);
  tft.setTextColor(RED);  
  tft.setTextSize(1);
  tft.println("Hello World!");

  tft.setTextColor(GREEN);  
  tft.setTextSize(2);
  tft.println("Hello World!");
  
  tft.setTextColor(BLUE);  
  tft.setTextSize(3);
  tft.println("Hello World!");
}

void test3D() {
  tft.fillScreen(WHITE);
  r[0]=r[0]+1;
  r[1]=r[1]+1;
  if (r[0] == 36) r[0] = 0;
  if (r[1] == 36) r[1] = 0;
  if (r[2] == 36) r[2] = 0;
  for (int i=0;i<8;i++)
  {
    float px2 = px[i];
    float py2 = cos_d[r[0]]*py[i] - sin_d[r[0]]*pz[i];
    float pz2 = sin_d[r[0]]*py[i] + cos_d[r[0]]*pz[i];

    float px3 = cos_d[r[1]]*px2 + sin_d[r[1]]*pz2;
    float py3 = py2;
    float pz3 = -sin_d[r[1]]*px2 + cos_d[r[1]]*pz2;

    float ax = cos_d[r[2]]*px3 - sin_d[r[2]]*py3;
    float ay = sin_d[r[2]]*px3 + cos_d[r[2]]*py3;
    float az = pz3-190;

    p2x[i] = ((tft.width())/2)+ax*500/az;
    p2y[i] = ((tft.height())/2)+ay*500/az;
  }
  for (int i=0;i<3;i++) {
    tft.drawLine(p2x[i],p2y[i],p2x[i+1],p2y[i+1],BLACK);
    tft.drawLine(p2x[i+4],p2y[i+4],p2x[i+5],p2y[i+5],BLACK);
    tft.drawLine(p2x[i],p2y[i],p2x[i+4],p2y[i+4],BLACK);
  }   
  tft.drawLine(p2x[3],p2y[3],p2x[0],p2y[0],BLACK);
  tft.drawLine(p2x[7],p2y[7],p2x[4],p2y[4],BLACK);
  tft.drawLine(p2x[3],p2y[3],p2x[7],p2y[7],BLACK);
}


